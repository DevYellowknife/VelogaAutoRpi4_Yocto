## build/conf/bblayers.conf
```bitbake
# POKY_BBLAYERS_CONF_VERSION is increased each time build/conf/bblayers.conf
# changes incompatibly
POKY_BBLAYERS_CONF_VERSION = "2"

BBPATH = "${TOPDIR}"
BBFILES ?= ""
BSPDIR := "${@os.path.abspath(os.path.dirname(d.getVar('FILE')) + '/../..')}"

BBLAYERS ?= " \
  ${BSPDIR}/poky/meta \
  ${BSPDIR}/poky/meta-poky \
  ${BSPDIR}/poky/meta-yocto-bsp \
  ${BSPDIR}/poky/meta-raspberrypi \
  ${BSPDIR}/poky/meta-openembedded/meta-oe \
  ${BSPDIR}/poky/meta-openembedded/meta-multimedia \
  ${BSPDIR}/poky/meta-openembedded/meta-python \
  ${BSPDIR}/poky/meta-qt6 \
  ${BSPDIR}/poky/meta-openembedded/meta-perl \
  ${BSPDIR}/poky/meta-openembedded/meta-networking \
  ${BSPDIR}/poky/meta-yellowknife \
"
```

## sources/meta-toradex-nxp/conf/machine/apalis-imx8.conf
```bitbake
#@TYPE: Machine
#@NAME: Toradex Apalis iMX8
#@DESCRIPTION: Toradex Apalis iMX8 powered by a i.MX 8QuadMax SoC
#@MAINTAINER: Stefan Agner <stefan.agner@toradex.com>

MACHINE_NAME = "Apalis-iMX8"

SOC_SILICON_REV ?= ""

MACHINEOVERRIDES =. "mx8:mx8qm:"

require conf/machine/include/imx-base.inc
require conf/machine/include/arm/arch-arm64.inc

# Don't include kernels in standard images
RDEPENDS_${KERNEL_PACKAGE_NAME}-base = ""

LOADADDR = ""

# we do not want to have getty running on tty1 as we run
# auto-serial-console there
USE_VT = "0"

KERNEL_DEVICETREE = " \
    freescale/fsl-imx8qm-apalis-eval.dtb \
    freescale/fsl-imx8qm-apalis-eval-ar0521.dtb \
    freescale/fsl-imx8qm-apalis-ixora-v1.1.dtb \
    freescale/fsl-imx8qm-apalis-ixora-v1.1-ar0521.dtb \
    freescale/fsl-imx8qm-apalis-v1.1-eval.dtb \
    freescale/fsl-imx8qm-apalis-v1.1-eval-ar0521.dtb \
"

UBOOT_SUFFIX = "bin"
UBOOT_CONFIG ??= "sd"
UBOOT_CONFIG[sd] = "apalis-imx8_defconfig,sdcard"

UBOOT_ENTRYPOINT = "0x80280000"
UBOOT_RD_LOADADDRESS = "0xA0000000"

BOOT_SPACE = "65536"
IMAGE_BOOTLOADER = "imx-boot"
IMX_BOOT_SEEK = "32"

MACHINE_BOOT_FILES = "boot.scr hdmitxfw.bin dpfw.bin"
IMAGE_BOOT_FILES_append = " ${MACHINE_BOOT_FILES}"
WKS_FILE_DEPENDS_append = " firmware-imx-8 u-boot-distro-boot"

PREFERRED_PROVIDER_virtual/kernel = "linux-toradex"
PREFERRED_PROVIDER_virtual/kernel_preempt-rt = "linux-toradex-rt"
PREFERRED_PROVIDER_virtual/bootloader = "u-boot-toradex"
PREFERRED_PROVIDER_u-boot-fw-utils ?= "u-boot-toradex-fw-utils"
# Currently we use the nxp 2018.03 downstream for mx8 as some features are
# not yet available in 2019.03.
PREFERRED_VERSION_u-boot-toradex = "2018.03"
PREFERRED_VERSION_u-boot-toradex-fw-utils = "2018.03"

MACHINE_FIRMWARE_append = " linux-firmware-pcie8997"
MACHINE_FIRMWARE_append = " firmware-imx-vpu-imx8"

IMXBOOT_TARGETS = "flash_b0"

BOARD_TYPE = "apalis"

IMAGE_CLASSES_append = " image_type_tezi"
IMAGE_FSTYPES += "teziimg"

# The imx-boot container takes care for the i.MX 8 offset, so the container
# has to be flashed at offset 0 directly
UBOOT_BINARY_TEZI_EMMC = "imx-boot"
OFFSET_BOOTROM_PAYLOAD = "0"

TORADEX_PRODUCT_IDS = "0037 0047 0048 0049"
TORADEX_PRODUCT_IDS[0037] = "fsl-imx8qm-apalis.dtb"
TORADEX_PRODUCT_IDS[0047] = "fsl-imx8qm-apalis.dtb"
TORADEX_PRODUCT_IDS[0048] = "fsl-imx8qm-apalis.dtb"
TORADEX_PRODUCT_IDS[0049] = "fsl-imx8qm-apalis.dtb"
```

## sources/meta-toradex-nxp/conf/machine/apalis-imx8x-v11a.conf
```bitbake
#@TYPE: Machine
#@NAME: Toradex Apalis iMX8X with B0 silicon
#@DESCRIPTION: Toradex Apalis iMX8X powered by a i.MX 8X SoC (B0 silicon) as found on all V1.0 and V1.1A versions
#@MAINTAINER: Philippe Schenker <philippe.schenker@toradex.com>

# for C0 silicon add mx8qxpc0:,
# for B0 silicon use empty string
SILICON-OVERRIDES = ""

# keep the original machine as an override with high prio
MACHINEOVERRIDES =. "apalis-imx8x:"

require conf/machine/apalis-imx8x.conf

# reuse DISTRO_FLAVOUR to display special version exception in the
# Toradex Easy Installer application
DISTRO_FLAVOUR_append = " for V1.1A HW"
MACHINE_NAME = "Apalis-iMX8X-V11A"
```

## sources/meta-toradex-nxp/conf/machine/colibri-imx8x-v10b.conf
```bitbake
#@TYPE: Machine
#@NAME: Toradex Colibri iMX8X with B0 silicon
#@DESCRIPTION: Toradex Colibri iMX8X powered by a i.MX 8X SoC (B0 silicon) as found on older SoM Versions V1.0B
#@MAINTAINER: Max Krummenacher <max.krummenacherr@toradex.com>

# for C0 silicon add mx8qxpc0:,
# for B0 silicon use empty string
SILICON-OVERRIDES = ""

# keep the original machine as an override with high prio
MACHINEOVERRIDES =. "colibri-imx8x:"

require conf/machine/colibri-imx8x.conf

# reuse DISTRO_FLAVOUR to display special version exception in the
# Toradex Easy Installer application
DISTRO_FLAVOUR_append = " for V1.0B HW"
MACHINE_NAME = "Colibri-iMX8X-V10B"
```

## sources/meta-toradex-nxp/conf/machine/include/apalis-imx6.inc
```bitbake
IMAGE_CLASSES_append = " image_type_tezi"
IMAGE_FSTYPES += "teziimg"
TORADEX_PRODUCT_IDS = "0027 0028 0029 0035"
# The payload offsets are given in number of 512 byte blocks.
OFFSET_BOOTROM_PAYLOAD = "2"
OFFSET_SPL_PAYLOAD = "138"

MACHINE_NAME = "Apalis-iMX6"

MACHINEOVERRIDES_append_upstream = ":use-mainline-bsp"

MACHINE_BOOT_FILES = "boot.scr"
IMAGE_BOOT_FILES_append = " ${MACHINE_BOOT_FILES}"
WKS_FILE_DEPENDS_append = " u-boot-distro-boot"

KERNEL_IMAGETYPE_${MACHINE} = "zImage"
KERNEL_DEVICETREE += "imx6q-apalis-ixora-v1.2.dtb"
KERNEL_DEVICETREE_use-mainline-bsp += " \
    imx6q-apalis-eval.dtb \
    imx6q-apalis-ixora-v1.1.dtb \
"

PREFERRED_PROVIDER_virtual/kernel_preempt-rt = "linux-toradex-rt"
PREFERRED_PROVIDER_virtual/kernel_use-mainline-bsp = "linux-toradex-mainline"
PREFERRED_PROVIDER_virtual/kernel_use-mainline-bsp_preempt-rt = "linux-toradex-mainline"
PREFERRED_PROVIDER_virtual/dtb_use-mainline-bsp = "device-tree-overlays-mainline"

UBOOT_SUFFIX = "img"

MACHINE_FIRMWARE_remove = "firmware-imx-epdc"

# As per meta-freescale commit 927b31771dab ("xf86-video-imx-vivante: Remove fb
# from name") this package got renamed. Use new one!
XSERVER_DRIVER_apalis-imx6 = "xf86-video-imx-vivante"
```

## sources/meta-toradex-nxp/conf/machine/include/colibri-imx6.inc
```bitbake
IMAGE_CLASSES_append = " image_type_tezi"
IMAGE_FSTYPES += "teziimg"
TORADEX_PRODUCT_IDS = "0014 0015 0016 0017"
# The payload offsets are given in number of 512 byte blocks.
OFFSET_BOOTROM_PAYLOAD = "2"
OFFSET_SPL_PAYLOAD = "138"

MACHINE_NAME = "Colibri-iMX6"

MACHINEOVERRIDES_append_upstream = ":use-mainline-bsp"

MACHINE_BOOT_FILES = "boot.scr"
IMAGE_BOOT_FILES_append = " ${MACHINE_BOOT_FILES}"
WKS_FILE_DEPENDS_append = " u-boot-distro-boot"

KERNEL_IMAGETYPE_${MACHINE} = "zImage"
KERNEL_DEVICETREE += "imx6dl-colibri-iris.dtb imx6dl-colibri-iris-v2.dtb"
PREFERRED_PROVIDER_virtual/kernel_preempt-rt = "linux-toradex-rt"
PREFERRED_PROVIDER_virtual/kernel_use-mainline-bsp = "linux-toradex-mainline"
PREFERRED_PROVIDER_virtual/kernel_use-mainline-bsp_preempt-rt = "linux-toradex-mainline"
PREFERRED_PROVIDER_virtual/dtb_use-mainline-bsp = "device-tree-overlays-mainline"

UBOOT_SUFFIX = "img"

MACHINE_FIRMWARE_remove = "firmware-imx-epdc"

# As per meta-freescale commit 927b31771dab ("xf86-video-imx-vivante: Remove fb
# from name") this package got renamed. Use new one!
XSERVER_DRIVER_colibri-imx6 = "xf86-video-imx-vivante"
```

## sources/meta-toradex-nxp/conf/machine/include/colibri-imx6ull.inc
```bitbake
IMAGE_CLASSES += "image_type_tezi"
IMAGE_FSTYPES += "teziimg"
TORADEX_PRODUCT_IDS = "0036 0040 0044 0045"
TORADEX_PRODUCT_IDS[0036] = "imx6ull-colibri-eval-v3.dtb"
TORADEX_PRODUCT_IDS[0040] = "imx6ull-colibri-wifi-eval-v3.dtb"
TORADEX_PRODUCT_IDS[0044] = "imx6ull-colibri-eval-v3.dtb"
TORADEX_PRODUCT_IDS[0045] = "imx6ull-colibri-wifi-eval-v3.dtb"
TORADEX_FLASH_TYPE = "rawnand"

IMAGE_FSTYPES += "wic.gz"
WIC_CREATE_EXTRA_ARGS_append = " --no-fstab-update"

MACHINE_NAME = "Colibri-iMX6ULL"

MACHINEOVERRIDES_append_upstream = ":use-mainline-bsp"

MACHINE_BOOT_FILES = "boot.scr"
IMAGE_BOOT_FILES_append = " ${MACHINE_BOOT_FILES}"
WKS_FILE_DEPENDS_append = " u-boot-distro-boot"

UBOOT_ENTRYPOINT_colibri-imx6ull = "0x81000000"
UBOOT_MAKE_TARGET_colibri-imx6ull = "u-boot.imx"

KERNEL_DEVICETREE += " \
    imx6ull-colibri-aster.dtb imx6ull-colibri-wifi-aster.dtb \
    imx6ull-colibri-iris.dtb imx6ull-colibri-wifi-iris.dtb \
    imx6ull-colibri-iris-v2.dtb imx6ull-colibri-wifi-iris-v2.dtb \
"
KERNEL_DEVICETREE_use-mainline-bsp = "imx6ull-colibri-eval-v3.dtb imx6ull-colibri-wifi-eval-v3.dtb"
PREFERRED_PROVIDER_virtual/kernel_preempt-rt = "linux-toradex-rt"
PREFERRED_PROVIDER_virtual/kernel_use-mainline-bsp = "linux-toradex-mainline"
PREFERRED_PROVIDER_virtual/kernel_use-mainline-bsp_preempt-rt = "linux-toradex-mainline"
PREFERRED_PROVIDER_virtual/dtb_use-mainline-bsp = "device-tree-overlays-mainline"
```

## sources/meta-toradex-nxp/conf/machine/include/colibri-imx7-emmc.inc
```bitbake
IMAGE_CLASSES += "image_type_tezi"
IMAGE_FSTYPES += "teziimg"
# The payload offsets are given in number of 512 byte blocks.
OFFSET_BOOTROM_PAYLOAD = "2"
TORADEX_PRODUCT_IDS = "0039"
TORADEX_FLASH_TYPE = "emmc"

MACHINE_NAME = "Colibri-iMX7-eMMC"

MACHINEOVERRIDES_append_upstream = ":use-mainline-bsp"

MACHINE_BOOT_FILES = "boot.scr"
IMAGE_BOOT_FILES_append = " ${MACHINE_BOOT_FILES}"
WKS_FILE_DEPENDS_append = " u-boot-distro-boot"

MACHINE_FIRMWARE_remove = "firmware-imx-epdc"

PREFERRED_PROVIDER_virtual/kernel_preempt-rt = "linux-toradex-rt"
PREFERRED_PROVIDER_virtual/kernel_use-mainline-bsp = "linux-toradex-mainline"
PREFERRED_PROVIDER_virtual/kernel_use-mainline-bsp_preempt-rt = "linux-toradex-mainline"
PREFERRED_PROVIDER_virtual/dtb_use-mainline-bsp = "device-tree-overlays-mainline"

KERNEL_DEVICETREE_use-mainline-bsp = " \
    imx7d-colibri-emmc-aster.dtb imx7d-colibri-emmc-eval-v3.dtb \
"
```

## sources/meta-toradex-nxp/conf/machine/include/colibri-imx7.inc
```bitbake
IMAGE_CLASSES_append = " image_type_tezi"
IMAGE_FSTYPES += "teziimg"
TORADEX_PRODUCT_IDS = "0032 0033 0041"
TORADEX_PRODUCT_IDS[0032] = "imx7s-colibri-eval-v3.dtb"
TORADEX_PRODUCT_IDS[0033] = "imx7d-colibri-eval-v3.dtb"
TORADEX_PRODUCT_IDS[0041] = "imx7d-colibri-eval-v3.dtb"
TORADEX_FLASH_TYPE = "rawnand"

MACHINE_NAME = "Colibri-iMX7"

MACHINEOVERRIDES_append_upstream = ":use-mainline-bsp"

MACHINE_BOOT_FILES = "boot.scr"
IMAGE_BOOT_FILES_append = " ${MACHINE_BOOT_FILES}"
WKS_FILE_DEPENDS_append = " u-boot-distro-boot"

MACHINE_FIRMWARE_remove = "firmware-imx-epdc"

KERNEL_DEVICETREE += " \
    imx7d-colibri-iris.dtb imx7s-colibri-iris.dtb \
    imx7d-colibri-iris-v2.dtb imx7s-colibri-iris-v2.dtb \
"
KERNEL_DEVICETREE_use-mainline-bsp += " \
    imx7d-colibri-eval-v3.dtb imx7s-colibri-eval-v3.dtb \
    imx7d-colibri-aster.dtb imx7s-colibri-aster.dtb \
"
PREFERRED_PROVIDER_virtual/kernel_preempt-rt = "linux-toradex-rt"
PREFERRED_PROVIDER_virtual/kernel_use-mainline-bsp = "linux-toradex-mainline"
PREFERRED_PROVIDER_virtual/kernel_use-mainline-bsp_preempt-rt = "linux-toradex-mainline"
PREFERRED_PROVIDER_virtual/dtb_use-mainline-bsp = "device-tree-overlays-mainline"

UBOOT_MAKE_TARGET_colibri-imx7 = "u-boot.imx"
```

## sources/meta-toradex-nxp/conf/machine/verdin-imx8mm.conf
```bitbake
#@TYPE: Machine
#@NAME: Toradex Verdin iMX8M Mini
#@SOC: i.MX8MM
#@DESCRIPTION: Machine configuration for Toradex Verdin iMX8M Mini SoM
#@MAINTAINER: Max Krummenacher <max.krummenacher@toradex.com>

MACHINE_NAME = "Verdin-iMX8MM"

MACHINEOVERRIDES =. "mx8:mx8m:mx8mm:"

require conf/machine/include/imx-base.inc
# if one wants cortexa53-crypto, set DEFAULTTUNE accordingly
DEFAULTTUNE_mx8mm = "aarch64"
require conf/machine/include/tune-cortexa53.inc

# Don't include kernels in standard images
RDEPENDS_${KERNEL_PACKAGE_NAME}-base = ""

KERNEL_DEVICETREE = " \
    freescale/fsl-imx8mm-verdin-nonwifi-dahlia.dtb \
    freescale/fsl-imx8mm-verdin-nonwifi-dev.dtb \
    freescale/fsl-imx8mm-verdin-wifi-dahlia.dtb \
    freescale/fsl-imx8mm-verdin-wifi-dev.dtb \
"

UBOOT_CONFIG ??= "sd"
UBOOT_CONFIG[sd] = "verdin-imx8mm_defconfig,sdcard"
SPL_BINARY = "spl/u-boot-spl.bin"

UBOOT_ENTRYPOINT = "0x80280000"
UBOOT_RD_LOADADDRESS = "0xA0000000"

# Set DDR FIRMWARE
DDR_FIRMWARE_NAME = "lpddr4_pmu_train_1d_imem.bin lpddr4_pmu_train_1d_dmem.bin lpddr4_pmu_train_2d_imem.bin lpddr4_pmu_train_2d_dmem.bin"

# Set u-boot DTB
UBOOT_DTB_NAME = "fsl-imx8mm-verdin.dtb"

BOOT_SPACE = "65536"
IMAGE_BOOTLOADER = "imx-boot"

# Set imx-mkimage boot target
IMXBOOT_TARGETS = "flash_evk_emmc_fastboot"

MACHINE_BOOT_FILES = "boot.scr"
IMAGE_BOOT_FILES_append = " ${MACHINE_BOOT_FILES}"
WKS_FILE_DEPENDS_append = " u-boot-distro-boot"

LOADADDR = ""
UBOOT_SUFFIX = "bin"
UBOOT_MAKE_TARGET = ""
IMX_BOOT_SEEK = "33"

SERIAL_CONSOLES = "115200;ttymxc0"

MACHINE_FEATURES += "3g bluetooth alsa ext2 pci screen touchscreen usbgadget usbhost vfat wifi"


# Add additional firmware
MACHINE_FIRMWARE_append = " linux-firmware-ath10k linux-firmware-imx-sdma-imx7d"

PREFERRED_PROVIDER_virtual/kernel = "linux-toradex"
PREFERRED_PROVIDER_virtual/kernel_preempt-rt = "linux-toradex-rt"
PREFERRED_PROVIDER_virtual/bootloader = "u-boot-toradex"
PREFERRED_PROVIDER_u-boot-fw-utils ?= "u-boot-toradex-fw-utils"
# Currently we use the nxp 2018.03 downstream for mx8 as some features are
# not yet available in 2019.03.
PREFERRED_VERSION_u-boot-toradex = "2018.03"
PREFERRED_VERSION_u-boot-toradex-fw-utils = "2018.03"

MACHINE_FIRMWARE_append = " linux-firmware-sd8997"
MACHINE_FIRMWARE_append = " firmware-imx-vpu-imx8"

BOARD_TYPE = "verdin"

IMAGE_CLASSES_append = " image_type_tezi"
IMAGE_FSTYPES += "teziimg"

UBOOT_BINARY_TEZI_EMMC = "imx-boot"
OFFSET_BOOTROM_PAYLOAD = "2"

TORADEX_PRODUCT_IDS = "0055 0057"
TORADEX_PRODUCT_IDS[0055] = "fsl-imx8mm-verdin-wifi-dev.dtb"
TORADEX_PRODUCT_IDS[0057] = "fsl-imx8mm-verdin-nonwifi-dev.dtb"
```

## sources/meta-yellowknife/conf/layer.conf
```bitbake
# We have a conf and classes directory, add to BBPATH
BBPATH .= ":${LAYERDIR}"

# We have recipes-* directories, add to BBFILES
BBFILES += "${LAYERDIR}/recipes-*/*/*.bb \
            ${LAYERDIR}/recipes-*/*/*.bbappend"

BBFILE_COLLECTIONS += "meta-yellowknife"
BBFILE_PATTERN_meta-yellowknife = "^${LAYERDIR}/"
BBFILE_PRIORITY_meta-yellowknife = "6"

LAYERDEPENDS_meta-yellowknife = "core"
LAYERSERIES_COMPAT_meta-yellowknife = "sumo thud warrior zeus"
```
